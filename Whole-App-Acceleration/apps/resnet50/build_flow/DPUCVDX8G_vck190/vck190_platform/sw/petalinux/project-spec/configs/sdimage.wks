## Whole-App-Acceleration/apps/resnet50/build_flow/DPUCVDX8G_vck190/vck190_platform/sw/petalinux/project-spec/configs/sdimage.wks
```
# Description: Creates a partitioned SD card image. Boot files
# are located in the first vfat partition. Rootfs will be in second ext4 partition.

part /boot --source bootimg-partition --ondisk mmcblk0 --fstype=vfat --label boot --active --align 4
part / --source rootfs --ondisk mmcblk0 --fstype=ext4 --label root --align 4
```

## dsa/XVDPU-TRD/vck190_platform/sw/petalinux/project-spec/meta-base-trd/conf/layer.conf
```bitbake
# We have a conf and classes directory, add to BBPATH
BBPATH .= ":${LAYERDIR}"

# We have recipes-* directories, add to BBFILES
BBFILES += " \
	${LAYERDIR}/recipes-*/*.bb \
	${LAYERDIR}/recipes-*/*.bbappend \
	${LAYERDIR}/recipes-*/*/*.bb \
	${LAYERDIR}/recipes-*/*/*.bbappend \
	"

BBFILE_COLLECTIONS += "meta-base-trd"
BBFILE_PATTERN_meta-base-trd = "^${LAYERDIR}/"
BBFILE_PRIORITY_meta-base-trd = "6"

LAYERDEPENDS_meta-base-trd = "petalinux jupyter-layer"

LAYERSERIES_COMPAT_meta-base-trd = "zeus"
```
